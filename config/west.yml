## config/west.yml
```yaml
manifest:
  remotes:
    - name: zmkfirmware
      url-base: https://github.com/petejohanson
    - name: kumamuk-git
      url-base: https://github.com/kumamuk-git
    - name: razily-sub
      url-base: https://github.com/razily-sub
  projects:
    - name: zmk
      remote: zmkfirmware
      revision: feat/pointers-move-scroll
      import: app/west.yml
    - name: zmk-pmw3610-driver
      remote: razily-sub
      revision: main
  self:
    path: config
```
